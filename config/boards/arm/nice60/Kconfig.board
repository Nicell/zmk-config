## config/boards/arm/nice60/Kconfig.board
```kconfig
# nice!60 board configuration

# Copyright (c) 2020 Nick Winans
# SPDX-License-Identifier: MIT

config BOARD_NICE60
	bool "nice!60"
	depends on SOC_NRF52840_QIAA
```

## config/boards/arm/nice60/nice60_defconfig
```kconfig
# SPDX-License-Identifier: MIT

CONFIG_SOC_SERIES_NRF52X=y
CONFIG_SOC_NRF52840_QIAA=y
CONFIG_BOARD_NICE60=y

# Enable MPU
CONFIG_ARM_MPU=y

# enable GPIO
CONFIG_GPIO=y

CONFIG_USE_DT_CODE_PARTITION=y

CONFIG_MPU_ALLOW_FLASH_WRITE=y
CONFIG_NVS=y
CONFIG_SETTINGS_NVS=y
CONFIG_FLASH=y
CONFIG_FLASH_PAGE_LAYOUT=y
CONFIG_FLASH_MAP=y

CONFIG_ZMK_RGB_UNDERGLOW=y
CONFIG_WS2812_STRIP=y

# Turn on logging, and set ZMK logging to debug output
CONFIG_LOG=y
CONFIG_ZMK_LOG_LEVEL_DBG=y

# Turn on USB CDC ACM device
CONFIG_USB=y
CONFIG_USB_DEVICE_STACK=y
CONFIG_USB_CDC_ACM=y
CONFIG_USB_CDC_ACM_RINGBUF_SIZE=1024
CONFIG_USB_CDC_ACM_DEVICE_NAME="CDC_ACM"
CONFIG_USB_CDC_ACM_DEVICE_COUNT=1

# Enable serial console
CONFIG_SERIAL=y
CONFIG_CONSOLE=y
CONFIG_UART_INTERRUPT_DRIVEN=y
CONFIG_UART_LINE_CTRL=y

# Enable USB UART, and set the console device
CONFIG_UART_CONSOLE=y
CONFIG_USB_UART_CONSOLE=y
CONFIG_UART_CONSOLE_ON_DEV_NAME="CDC_ACM_0"
```

## config/boards/shields/mdk_trio/Kconfig.defconfig
```kconfig
# Copyright (c) 2020 Pete Johanson, Richard Jones
# SPDX-License-Identifier: MIT

if SHIELD_MDK_TRIO

config ZMK_KEYBOARD_NAME
	default "MDK Trio"

config ZMK_DISPLAY
	select LVGL_USE_CONT
	select LVGL_FONT_MONTSERRAT_26

if ZMK_DISPLAY

choice LVGL_THEME_DEFAULT_FONT_NORMAL
    default LVGL_THEME_DEFAULT_FONT_NORMAL_MONTSERRAT_26

endchoice

choice LVGL_THEME_DEFAULT_FONT_SMALL
    default LVGL_THEME_DEFAULT_FONT_SMALL_MONTSERRAT_26

endchoice


config LVGL_HOR_RES_MAX
	default 160

config LVGL_VER_RES_MAX
	default 68

config SPI
	default y

config LS0XX
	default y

config LVGL_BITS_PER_PIXEL
	default 1

choice LVGL_COLOR_DEPTH
	default LVGL_COLOR_DEPTH_1

endchoice

config LVGL_DPI
	default 30

config LVGL_VDB_SIZE
	default 16

endif # ZMK_DISPLAY

endif
```

## config/boards/shields/mdk_trio/boards/nice_nano.conf
```kconfig
CONFIG_ZMK_DISPLAY=y
CONFIG_LVGL_USE_THEME_MONO=y
CONFIG_ZMK_USB_LOGGING=y
CONFIG_DISPLAY_LOG_LEVEL_DBG=y
CONFIG_ZMK_LOG_LEVEL_DBG=y
CONFIG_LVGL_LOG_LEVEL_INF=y
```

## config/boards/shields/mdk_trio/boards/nrf52840dk_nrf52840.conf
```kconfig
CONFIG_LVGL_HOR_RES_MAX=80
CONFIG_LVGL_VER_RES_MAX=128
CONFIG_SPI=y
CONFIG_IL0323=y
CONFIG_SSD16XX=n
CONFIG_SSD1306=n
CONFIG_LVGL_BITS_PER_PIXEL=1
CONFIG_LVGL_COLOR_DEPTH_1=y
CONFIG_LVGL_DPI=145
CONFIG_LVGL_VDB_SIZE=32
CONFIG_LVGL_USE_THEME_MONO=y
CONFIG_ZMK_USB=y
CONFIG_ZMK_BLE=y
CONFIG_USE_SEGGER_RTT=y
CONFIG_RTT_CONSOLE=y
CONFIG_UART_CONSOLE=n
CONFIG_LOG=y
CONFIG_LOG_BUFFER_SIZE=4096
CONFIG_LOG_STRDUP_BUF_COUNT=16

CONFIG_MPU_ALLOW_FLASH_WRITE=y
CONFIG_NVS=y
CONFIG_SETTINGS_NVS=y
CONFIG_FLASH=y
CONFIG_FLASH_PAGE_LAYOUT=y
CONFIG_FLASH_MAP=y

CONFIG_SYSTEM_WORKQUEUE_STACK_SIZE=4096
CONFIG_MAIN_STACK_SIZE=4096
CONFIG_ZMK_LOG_LEVEL_DBG=y
CONFIG_DISPLAY_LOG_LEVEL_DBG=y
CONFIG_SEGGER_RTT_BUFFER_SIZE_UP=4096

CONFIG_ZMK_BATTERY_VOLTAGE_DIVIDER=n
```

## config/boards/shields/nice60/Kconfig.defconfig
```kconfig
if SHIELD_NICE60

config ZMK_KEYBOARD_NAME
	default "nice!60"

config ZMK_RGB_UNDERGLOW
	default y

endif
```

## config/west.yml
```yaml
manifest:
  remotes:
    - name: zmkfirmware
      url-base: https://github.com/zmkfirmware
    - name: nicell
      url-base: https://github.com/nicell
    - name: petejohanson
      url-base: https://github.com/petejohanson
    - name: careyk007
      url-base: https://github.com/careyk007
    - name: innovaker
      url-base: https://github.com/innovaker
  projects:
    - name: zmk
      remote: petejohanson
      revision: core/ble-split-central-notify-main-thread
      import: app/west.yml
  self:
    path: config
```
