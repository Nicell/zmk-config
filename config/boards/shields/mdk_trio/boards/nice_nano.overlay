&i2c0 {
	status = "disabled";
};

&spi1 {
	status = "okay";
	compatible = "nordic,nrf-spim";
	sck-pin = <20>;
	mosi-pin = <17>;
	miso-pin = <24>;
	cs-gpios = <&gpio0 22 GPIO_ACTIVE_HIGH>;

	ls0xx@0 {
		compatible = "sharp,ls0xx";
		label = "DISPLAY";
		spi-max-frequency = <2000000>;
		reg = <0>;
		width = <160>;
		height = <68>;
		disp-en-gpios = <&gpio0 2 GPIO_ACTIVE_HIGH>;
	};
};
