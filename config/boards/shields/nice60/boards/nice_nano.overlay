&spi0 {
	compatible = "nordic,nrf-spim";
	/* Cannot be used together with i2c0. */
	status = "okay";
	sck-pin = <26>;
	mosi-pin = <22>;
	miso-pin = <12>;

	led_strip: ws2812@0 {
		compatible = "worldsemi,ws2812-spi";
		label = "WS2812";

		/* SPI */
		reg = <0>; /* ignored, but necessary for SPI bindings */
		spi-max-frequency = <4000000>;

		/* WS2812 */
		chain-length = <8>; /* arbitrary; change at will */
		spi-one-frame = <0x70>;
		spi-zero-frame = <0x40>;
	};
};

/ {
	chosen {
		zmk,underglow = &led_strip;
	};
};
